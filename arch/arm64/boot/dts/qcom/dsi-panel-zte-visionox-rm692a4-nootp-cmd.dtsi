/* Copyright (c) 2017-2018, The Linux Foundation. All rights reserved.
 *
 * This program is free software; you can redistribute it and/or modify
 * it under the terms of the GNU General Public License version 2 and
 * only version 2 as published by the Free Software Foundation.
 *
 * This program is distributed in the hope that it will be useful,
 * but WITHOUT ANY WARRANTY; without even the implied warranty of
 * MERCHANTABILITY or FITNESS FOR A PARTICULAR PURPOSE.  See the
 * GNU General Public License for more details.
 */

&mdss_mdp {
	dsi_visionox_rm692a4_nootp_cmd: qcom,dsi_visionox_rm692a4_nootp_cmd_display {
		qcom,mdss-dsi-panel-name =
				"Visionox-RM692A4-nootp-1080-2340-6P5Inch";
		qcom,mdss-dsi-panel-type = "dsi_cmd_mode";
		qcom,mdss-dsi-virtual-channel-id = <0>;
		qcom,mdss-dsi-stream = <0>;
		qcom,mdss-dsi-bpp = <24>;
		qcom,mdss-dsi-underflow-color = <0xff>;
		qcom,mdss-dsi-border-color = <0>;
		qcom,mdss-dsi-traffic-mode = "burst_mode";
		qcom,mdss-dsi-te-pin-select = <1>;
		qcom,mdss-dsi-te-dcs-command = <1>;
		qcom,mdss-dsi-te-check-enable;
		qcom,mdss-dsi-te-using-te-pin;
		qcom,mdss-dsi-bllp-eof-power-mode;
		qcom,mdss-dsi-bllp-power-mode;
		qcom,mdss-dsi-lane-0-state;
		qcom,mdss-dsi-lane-1-state;
		qcom,mdss-dsi-lane-2-state;
		qcom,mdss-dsi-lane-3-state;
		qcom,mdss-dsi-lp11-init;
		qcom,mdss-dsi-reset-sequence = <1 10>, <0 10>, <1 20>;
		qcom,mdss-dsi-tx-eot-append;
		qcom,mdss-dsi-post-init-delay = <1>;
		qcom,mdss-dsi-dma-trigger = "trigger_sw";
		qcom,mdss-dsi-mdp-trigger = "none";
		qcom,mdss-dsi-bl-min-level = <270>;
		qcom,mdss-dsi-bl-max-level = <3840>;
		qcom,mdss-dsi-bl-pmic-control-type = "bl_ctrl_dcs";
		qcom,mdss-pan-physical-width-dimension = <69>;
		qcom,mdss-pan-physical-height-dimension = <149>;

		qcom,mdss-dsi-display-timings {
			timing@0{
				qcom,mdss-dsi-panel-width = <1080>;
				qcom,mdss-dsi-panel-height = <2340>;
				qcom,mdss-dsi-h-front-porch = <26>;
				qcom,mdss-dsi-h-back-porch = <36>;
				qcom,mdss-dsi-h-pulse-width = <2>;
				qcom,mdss-dsi-h-sync-skew = <0>;
				qcom,mdss-dsi-v-back-porch = <4>;
				qcom,mdss-dsi-v-front-porch = <8>;
				qcom,mdss-dsi-v-pulse-width = <4>;
				qcom,mdss-dsi-h-sync-pulse = <0>;
				qcom,mdss-dsi-h-left-border = <0>;
				qcom,mdss-dsi-h-right-border = <0>;
				qcom,mdss-dsi-v-top-border = <0>;
				qcom,mdss-dsi-v-bottom-border = <0>;
				qcom,mdss-dsi-panel-framerate = <60>;
		qcom,mdss-dsi-on-command = [39 01 00 00 00 00 02 FE 40
			39 01 00 00 00 00 02 05 28
			39 01 00 00 00 00 02 06 20
			39 01 00 00 00 00 02 08 28
			39 01 00 00 00 00 02 09 20
			39 01 00 00 00 00 02 0A EA
			39 01 00 00 00 00 02 0B 44
			39 01 00 00 00 00 02 0C EA
			39 01 00 00 00 00 02 0D 14
			39 01 00 00 00 00 02 0F 92
			39 01 00 00 00 00 02 37 A2
			39 01 00 00 00 00 02 38 A2
			39 01 00 00 00 00 02 24 00
			39 01 00 00 00 00 02 26 00
			39 01 00 00 00 00 02 2D 28
			39 01 00 00 00 00 02 2F 28
			39 01 00 00 00 00 02 28 03
			39 01 00 00 00 00 02 2A 03
			39 01 00 00 00 00 02 20 8D
			39 01 00 00 00 00 02 21 8D
			39 01 00 00 00 00 02 4C 08
			39 01 00 00 00 00 02 46 39
			39 01 00 00 00 00 02 47 39
			39 01 00 00 00 00 02 16 0A
			39 01 00 00 00 00 02 FE 40
			39 01 00 00 00 00 02 6F 02
			39 01 00 00 00 00 02 4D 33
			39 01 00 00 00 00 02 4E 07
			39 01 00 00 00 00 02 A2 1A
			39 01 00 00 00 00 02 A3 1D
			39 01 00 00 00 00 02 D1 13
			39 01 00 00 00 00 02 FE 72
			39 01 00 00 00 00 02 69 FF
			39 01 00 00 00 00 02 FE 60
			39 01 00 00 00 00 02 EF FF
			39 01 00 00 00 00 02 F0 FF
			39 01 00 00 00 00 02 F2 FF
			39 01 00 00 00 00 02 F3 FF
			39 01 00 00 00 00 02 F4 FF
			39 01 00 00 00 00 02 FE 40
			39 01 00 00 00 00 02 74 2B
			39 01 00 00 00 00 02 75 33
			39 01 00 00 00 00 02 80 19
			39 01 00 00 00 00 02 FE 50
			39 01 00 00 00 00 02 E2 C0
			39 01 00 00 00 00 02 E3 30
			39 01 00 00 00 00 02 E4 CF
			39 01 00 00 00 00 02 FE 60
			39 01 00 00 00 00 02 00 84
			39 01 00 00 00 00 02 01 00
			39 01 00 00 00 00 02 02 00
			39 01 00 00 00 00 02 03 05
			39 01 00 00 00 00 02 04 00
			39 01 00 00 00 00 02 05 07
			39 01 00 00 00 00 02 06 70
			39 01 00 00 00 00 02 07 70
			39 01 00 00 00 00 02 08 00
			39 01 00 00 00 00 02 09 C4
			39 01 00 00 00 00 02 0A 00
			39 01 00 00 00 00 02 0B 02
			39 01 00 00 00 00 02 0C 01
			39 01 00 00 00 00 02 0D 00
			39 01 00 00 00 00 02 0E 05
			39 01 00 00 00 00 02 0F 70
			39 01 00 00 00 00 02 10 3C
			39 01 00 00 00 00 02 11 00
			39 01 00 00 00 00 02 12 C4
			39 01 00 00 00 00 02 13 00
			39 01 00 00 00 00 02 14 02
			39 01 00 00 00 00 02 15 01
			39 01 00 00 00 00 02 16 00
			39 01 00 00 00 00 02 17 04
			39 01 00 00 00 00 02 18 70
			39 01 00 00 00 00 02 19 3C
			39 01 00 00 00 00 02 1A 00
			39 01 00 00 00 00 02 1B C4
			39 01 00 00 00 00 02 1C 00
			39 01 00 00 00 00 02 1D 04
			39 01 00 00 00 00 02 1E 02
			39 01 00 00 00 00 02 1F 00
			39 01 00 00 00 00 02 20 05
			39 01 00 00 00 00 02 21 70
			39 01 00 00 00 00 02 22 05
			39 01 00 00 00 00 02 23 00
			39 01 00 00 00 00 02 24 C4
			39 01 00 00 00 00 02 25 00
			39 01 00 00 00 00 02 26 04
			39 01 00 00 00 00 02 27 02
			39 01 00 00 00 00 02 28 00
			39 01 00 00 00 00 02 29 03
			39 01 00 00 00 00 02 2A 70
			39 01 00 00 00 00 02 2B 05
			39 01 00 00 00 00 02 2D 00
			39 01 00 00 00 00 02 95 CE
			39 01 00 00 00 00 02 96 00
			39 01 00 00 00 00 02 97 00
			39 01 00 00 00 00 02 98 06
			39 01 00 00 00 00 02 99 00
			39 01 00 00 00 00 02 9A 09
			39 01 00 00 00 00 02 9B 70
			39 01 00 00 00 00 02 9C 70
			39 01 00 00 00 00 02 9D 80
			39 01 00 00 00 00 02 FE 72
			39 01 00 00 00 00 02 26 00
			39 01 00 00 00 00 02 27 0A
			39 01 00 00 00 00 02 FE 60
			39 01 00 00 00 00 02 C7 1F
			39 01 00 00 00 00 02 C8 00
			39 01 00 00 00 00 02 C9 10
			39 01 00 00 00 00 02 CA 1F
			39 01 00 00 00 00 02 CB 03
			39 01 00 00 00 00 02 CC 04
			39 01 00 00 00 00 02 CD 1F
			39 01 00 00 00 00 02 CE 01
			39 01 00 00 00 00 02 CF 02
			39 01 00 00 00 00 02 D0 1F
			39 01 00 00 00 00 02 D1 1F
			39 01 00 00 00 00 02 D2 1F
			39 01 00 00 00 00 02 D3 1F
			39 01 00 00 00 00 02 D4 1F
			39 01 00 00 00 00 02 D5 1F
			39 01 00 00 00 00 02 D6 1F
			39 01 00 00 00 00 02 D7 1F
			39 01 00 00 00 00 02 D8 1F
			39 01 00 00 00 00 02 D9 1F
			39 01 00 00 00 00 02 DA 1F
			39 01 00 00 00 00 02 DB 1F
			39 01 00 00 00 00 02 DC 00
			39 01 00 00 00 00 02 DD 10
			39 01 00 00 00 00 02 DE 1F
			39 01 00 00 00 00 02 DF 03
			39 01 00 00 00 00 02 E0 04
			39 01 00 00 00 00 02 E1 1F
			39 01 00 00 00 00 02 E2 01
			39 01 00 00 00 00 02 E3 02
			39 01 00 00 00 00 02 E4 1F
			39 01 00 00 00 00 02 E5 1F
			39 01 00 00 00 00 02 E6 1F
			39 01 00 00 00 00 02 E7 1F
			39 01 00 00 00 00 02 E8 1F
			39 01 00 00 00 00 02 E9 1F
			39 01 00 00 00 00 02 EA 1F
			39 01 00 00 00 00 02 EB 1F
			39 01 00 00 00 00 02 EC 1F
			39 01 00 00 00 00 02 ED 1F
			39 01 00 00 00 00 02 EE 1F
			39 01 00 00 00 00 02 EF 03
			39 01 00 00 00 00 02 FE 70
			39 01 00 00 00 00 02 71 01
			39 01 00 00 00 00 02 72 30
			39 01 00 00 00 00 02 C3 82
			39 01 00 00 00 00 02 FE 72
			39 01 00 00 00 00 02 4B 37
			39 01 00 00 00 00 02 4C 42
			39 01 00 00 00 00 02 4D 45
			39 01 00 00 00 00 02 52 0F
			39 01 00 00 00 00 02 FE 74
			39 01 00 00 00 00 02 00 00
			39 01 00 00 00 00 02 01 00
			39 01 00 00 00 00 02 02 00
			39 01 00 00 00 00 02 03 0F
			39 01 00 00 00 00 02 04 0F
			39 01 00 00 00 00 02 05 00
			39 01 00 00 00 00 02 06 00
			39 01 00 00 00 00 02 07 00
			39 01 00 00 00 00 02 08 00
			39 01 00 00 00 00 02 09 00
			39 01 00 00 00 00 02 0A 00
			39 01 00 00 00 00 02 0B 00
			39 01 00 00 00 00 02 0C 00
			39 01 00 00 00 00 02 0D FF
			39 01 00 00 00 00 02 0E 40
			39 01 00 00 00 00 02 0F 00
			39 01 00 00 00 00 02 10 00
			39 01 00 00 00 00 02 11 00
			39 01 00 00 00 00 02 12 00
			39 01 00 00 00 00 02 13 00
			39 01 00 00 00 00 02 14 20
			39 01 00 00 00 00 02 15 00
			39 01 00 00 00 00 02 16 00
			39 01 00 00 00 00 02 17 00
			39 01 00 00 00 00 02 18 00
			39 01 00 00 00 00 02 19 40
			39 01 00 00 00 00 02 1A 00
			39 01 00 00 00 00 02 1B F0
			39 01 00 00 00 00 02 1C F4
			39 01 00 00 00 00 02 1D FF
			39 01 00 00 00 00 02 1E FF
			39 01 00 00 00 00 02 1F FF
			39 01 00 00 00 00 02 20 00
			39 01 00 00 00 00 02 21 FF
			39 01 00 00 00 00 02 22 FF
			39 01 00 00 00 00 02 23 FF
			39 01 00 00 00 00 02 24 FF
			39 01 00 00 00 00 02 25 FF
			39 01 00 00 00 00 02 26 FF
			39 01 00 00 00 00 02 27 FF
			39 01 00 00 00 00 02 28 FF
			39 01 00 00 00 00 02 29 FF
			39 01 00 00 00 00 02 38 00
			39 01 00 00 00 00 02 39 00
			39 01 00 00 00 00 02 3A FF
			39 01 00 00 00 00 02 3B FF
			39 01 00 00 00 00 02 3D FF
			39 01 00 00 00 00 02 3F FF
			39 01 00 00 00 00 02 40 FF
			39 01 00 00 00 00 02 41 FF
			39 01 00 00 00 00 02 42 FF
			39 01 00 00 00 00 02 43 FF
			39 01 00 00 00 00 02 44 FF
			39 01 00 00 00 00 02 45 FF
			39 01 00 00 00 00 02 46 FF
			39 01 00 00 00 00 02 47 FF
			39 01 00 00 00 00 02 48 FF
			39 01 00 00 00 00 02 49 FF
			39 01 00 00 00 00 02 4A FF
			39 01 00 00 00 00 02 58 40
			39 01 00 00 00 00 02 FE 90
			39 01 00 00 00 00 02 12 86
			39 01 00 00 00 00 02 13 61
			39 01 00 00 00 00 02 14 18
			39 01 00 00 00 00 02 15 24
			39 01 00 00 00 00 02 16 49
			39 01 00 00 00 00 02 17 92
			39 01 00 00 00 00 02 18 86
			39 01 00 00 00 00 02 19 61
			39 01 00 00 00 00 02 1A 18
			39 01 00 00 00 00 02 1B 24
			39 01 00 00 00 00 02 1C 49
			39 01 00 00 00 00 02 1D 92
			39 01 00 00 00 00 02 1E 86
			39 01 00 00 00 00 02 1F 61
			39 01 00 00 00 00 02 20 18
			39 01 00 00 00 00 02 21 24
			39 01 00 00 00 00 02 22 49
			39 01 00 00 00 00 02 23 92
			39 01 00 00 00 00 02 FE A0
			39 01 00 00 00 00 02 26 10
			39 01 00 00 00 00 02 31 50
			39 01 00 00 00 00 02 FE D0
			39 01 00 00 00 00 02 49 01
			39 01 00 00 00 00 02 FE 12
			39 01 00 00 00 00 02 AA C0
			39 01 00 00 00 00 02 AB 52
			39 01 00 00 00 00 02 AC 11
			39 01 00 00 00 00 02 AD 01
			39 01 00 00 00 00 02 AE BA
			39 01 00 00 00 00 02 AF 59
			39 01 00 00 00 00 02 FE 40
			39 01 00 00 00 00 02 9A 01
			39 01 00 00 00 00 02 FE 72
			39 01 00 00 00 00 02 69 60
			39 01 00 00 00 00 02 FE 60
			39 01 00 00 00 00 02 EF FF
			39 01 00 00 00 00 02 FE 40
			39 01 00 00 00 00 02 26 80
			39 01 00 00 00 00 02 FE 00
			39 01 00 00 00 00 0C 83 00 00 00 43 04 80 00 20 00 10 00
			39 01 00 00 00 00 02 C2 08
			39 01 00 00 00 00 02 35 00
			39 01 00 00 00 00 03 51 00 00
			05 01 00 00 78 00 02 11 00
			05 01 00 00 14 00 02 29 00];
				qcom,mdss-dsi-off-command = [
					05 01 00 00 32 00 02 28 00
					05 01 00 00 20 00 02 10 00
				];
				qcom,mdss-dsi-on-command-state = "dsi_lp_mode";
				qcom,mdss-dsi-off-command-state = "dsi_lp_mode";
				qcom,mdss-dsi-lp1-command = [
					39 01 00 00 00 00 02 FE 00
					05 01 00 00 00 00 02 39 00
				];
				qcom,mdss-dsi-lp1-command-state =
					"dsi_lp_mode";
				qcom,mdss-dsi-nolp-command = [
					39 01 00 00 00 00 02 FE 00
					05 01 00 00 00 00 02 38 00
				];
				qcom,mdss-dsi-nolp-command-state =
					"dsi_lp_mode";
			};
		};
	};
};
